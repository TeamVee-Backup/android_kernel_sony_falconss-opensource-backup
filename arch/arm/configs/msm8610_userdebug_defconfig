## arch/arm/configs/msm8610_userdebug_defconfig
```kconfig
####################################################################################
## This configuration only available for userdebug build if NEW configuration for it
## The rule of configuration for eng/userdebug/user build as below:
##
## eng build:msm8610_defconfig 
## userdebug build : msm8610-perf_defconfig + msm8610_userdebug_defconfig
## user build : msm8610-perf_defconfig
##
## So , if same configuration in userdebug and user build , then the file should be
## temp , The configuration in the file will replace same configuration in 
## msm8610-perf_defconfig 
####################################################################################
# << FerryWu, 2013/12/13, support forcing crash by long pressing power key only for eng and userdebug variants
CONFIG_INPUT_FORCE_CRASH=y
# >> FerryWu, 2013/12/13, support forcing crash by long pressing power key only for eng and userdebug variants
CONFIG_IKCONFIG_PROC=y
CONFIG_LOGCAT_SIZE=256
# /*++ ChampWang - 20131128 Add for future WD issue debugging ++*/
CONFIG_MSM_RTB=y
CONFIG_MSM_RTB_SEPARATE_CPUS=y
# /*-- ChampWang - 20131128 Add for future WD issue debugging --*/
CONFIG_CC_OPTIMIZE_FOR_SIZE=n
CONFIG_DEBUG_SPINLOCK=y
CONFIG_DEBUG_MUTEXES=y
CONFIG_DEBUG_ATOMIC_SLEEP=y
CONFIG_DEBUG_STACK_USAGE=y
CONFIG_DEBUG_LIST=y
#Kevin Shiu 20140317 enable dynamic debug log
CONFIG_DYNAMIC_DEBUG=y
#Kevin Shiu end
```

## arch/arm/configs/msm8610_userroot_defconfig
```kconfig
####################################################################################
## This configuration only available for userdebug build if NEW configuration for it
## The rule of configuration for eng/userdebug/user build as below:
##
## eng build:msm8610_defconfig 
## userdebug build : msm8610-perf_defconfig + msm8610_userdebug_defconfig
## user build : msm8610-perf_defconfig
##
## So , if same configuration in userdebug and user build , then the file should be
## temp , The configuration in the file will replace same configuration in 
## msm8610-perf_defconfig
####################################################################################
CONFIG_IKCONFIG_PROC=y
```
